## CMakeLists.txt
```
# SPDX-License-Identifier: Apache-2.0

cmake_minimum_required(VERSION 3.20.0)
set(CMAKE_EXPORT_COMPILE_COMMANDS ON)
find_package(Zephyr REQUIRED HINTS $ENV{ZEPHYR_BASE})
project(button)

target_sources(app PRIVATE src/main.c)
```

## Kconfig
```
source "Kconfig.zephyr"

menu "Wireless MIDI Keyboard: Receiver"

config RECV_LOG_LEVEL
    int "Log level for the Wireless MIDI Keyboard Receiver"
    default 4
endmenu
```

## sysbuild.conf
```
SB_CONFIG_BOOTLOADER_MCUBOOT=y
# SB_CONFIG_MCUBOOT_MODE_SWAP_USING_MOVE=y
# SB_CONFIG_BOOT_SIGNATURE_TYPE_NONE=y

# SB_CONFIG_BOOT_SIGNATURE_TYPE_ECDSA_P256=y
# SB_CONFIG_BOOT_SIGNATURE_KEY_FILE="\${APPLICATION_CONFIG_DIR}/secrets/priv.pem"
```

## prj.conf
```kconfig
# UART out
CONFIG_SERIAL=y
CONFIG_CONSOLE=y
CONFIG_UART_CONSOLE=y
CONFIG_STDOUT_CONSOLE=y
CONFIG_UART_LINE_CTRL=y

# UART thru USB
CONFIG_USB_DEVICE_STACK=y

# HW ID
CONFIG_HW_ID_LIBRARY=y

# GPIO
CONFIG_GPIO=y
CONFIG_GPIO_HOGS=y

# log
CONFIG_LOG=y
```

## app.overlay
```dts
/*
 * Copyright (c) 2021 Nordic Semiconductor ASA
 *
 * SPDX-License-Identifier: Apache-2.0
 */

&gpio0 {
    hog1 {
        gpio-hog;
        gpios = <4 GPIO_ACTIVE_HIGH>;
        output-high;
    };
};
```

## src/main.c
```c
#include <zephyr/drivers/clock_control.h>
#include <zephyr/drivers/clock_control/nrf_clock_control.h>
#include <zephyr/kernel.h>
#include <zephyr/logging/log.h>
#include <zephyr/sys/util.h>
#include <hw_id.h>

LOG_MODULE_REGISTER(recv, CONFIG_RECV_LOG_LEVEL);

int initialize_clocks(void) {
	int err;
	int res;
	struct onoff_manager *clk_mgr;
	struct onoff_client clk_cli;

	clk_mgr = z_nrf_clock_control_get_onoff(CLOCK_CONTROL_NRF_SUBSYS_HF);
	if (!clk_mgr) {
		LOG_ERR("Unable to get the Clock manager");
		return -ENXIO;
	}

	sys_notify_init_spinwait(&clk_cli.notify);

	err = onoff_request(clk_mgr, &clk_cli);
	if (err < 0) {
		LOG_ERR("Clock request failed: %d", err);
		return err;
	}

	do {
		err = sys_notify_fetch_result(&clk_cli.notify, &res);
		if (!err && res) {
			LOG_ERR("Clock could not be started: %d", res);
			return res;
		}
	} while (err);

	LOG_DBG("HF clock started");
	return 0;
}

int main() {
	int err;
	err = initialize_clocks();
	if (err) {
		return err;
	}
	char buf[HW_ID_LEN];

	err = hw_id_get(buf, HW_ID_LEN);

	if (err) {
		LOG_ERR("hw_id_get failed: %d\n", err);
		return err;
	}

	while (1) {
		k_msleep(1000);
		LOG_INF("hw_id: %s\n", buf);
	}
	return 0;
}
```
